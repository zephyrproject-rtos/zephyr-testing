## boards/qemu/rx/qemu_rx_defconfig
```kconfig
# Copyright (c) 2024 Renesas Electronics Corporation
# SPDX-License-Identifier: Apache-2.0

CONFIG_BUILD_OUTPUT_BIN=n
# Enable UART driver
CONFIG_SERIAL=y

# Enable console
CONFIG_CONSOLE=y
CONFIG_UART_CONSOLE=y

CONFIG_QEMU_ICOUNT_SHIFT=6
CONFIG_QEMU_ICOUNT=y
```

## samples/application_development/external_lib/sample.yaml
```yaml
sample:
  name: External Library
tests:
  test:
    platform_whitelist: qemu_x86
    tags: external
    harness: console
    harness_config:
      type: multi_line
      regex:
        - "mylib says: Hello World!"
        - "Hello World!"
```

## samples/mpu/mem_domain_apis_test/sample.yaml
```yaml
sample:
  name: Memory Domain APIs Test
tests:
  test:
    filter: CONFIG_ARCH_HAS_USERSPACE
    tags: samples
    harness: console
    harness_config:
      type: multi_line
      regex:
        - "app thread \\d \\(0x[0-9a-f]+\\) starts."
        - "main thread \\(0x[0-9a-f]+\\) is back."
        - "remove app0_parts0 from app0_domain."
        - "main thread \\(0x[0-9a-f]+\\) yields."
        - "destroy app0_domain."
```

## tests/kernel/semaphore/semaphore/testcase.yaml
```yaml
tests:
  kernel.semaphore:
    tags:
      - kernel
      - userspace
      - blah
    ignore_faults: true
```

## west.yml
```yaml
# The west manifest file for upstream Zephyr.
#
# The per-installation west configuration file, .west/config, sets the
# path to the project containing this file in the [manifest] section's
# "path" variable.
#
# You are free to create your own manifest files and put them in any
# repository you want, to create your own custom Zephyr installations.
# For example, you could create a manifest file in your own out of
# tree application directory, which would pull this zephyr repository
# in as an ordinary project.
#
# You can pass your manifest repositories to west init when creating a
# new Zephyr installation. See the west documentation for more
# information.

manifest:
  defaults:
    remote: upstream

  remotes:
    - name: upstream
      url-base: https://github.com/zephyrproject-rtos

  #
  # Please add items below based on alphabetical order
  projects:
    - name: cmsis
      revision: c3bd2094f92d574377f7af2aec147ae181aa5f8e
      path: modules/hal/cmsis
    - name: hal_altera
      revision: 23c1c1dd7a0c1cc9a399509d1819375847c95b97
      path: modules/hal/altera
    - name: fatfs
      revision: 1d1fcc725aa1cb3c32f366e0c53d7490d0fe1109
      path: modules/fs/fatfs
    - name: mbedtls
      revision: 5765cb7f75a9973ae9232d438e361a9d7bbc49e7
      path: modules/crypto/mbedtls
    - name: mcuboot
      revision: 2fce9769b191411d580bbc65b043956c2ae9307e
      path: bootloader/mcuboot
    - name: mcumgr
      revision: 5c5055f5a7565f8152d75fcecf07262928b4d56e
      path: modules/lib/mcumgr
    - name: net-tools
      revision: f49bd1354616fae4093bf36e5eaee43c51a55127
      path: tools/net-tools
    - name: hal_nxp
      revision: 0d11138724959e1162777d9206f841ccdf64348e
      path: modules/hal/nxp
    - name: segger
      revision: 3a52ab222133193802d3c3b4d21730b9b1f1d2f6
      path: modules/debug/segger
    - name: tinycbor
      path: modules/lib/tinycbor
      revision: 40daca97b478989884bffb5226e9ab73ca54b8c4
    - name: tinycrypt
      path: modules/crypto/tinycrypt
      revision: 3e9a49d2672ec01435ffbf0d788db6d95ef28de0
    - name: littlefs
      path: modules/fs/littlefs
      revision: 9e4498d1c73009acd84bb36036ee5e2869112a6c
    - name: hal_xtensa
      revision: 2f04b615cd5ad3a1b8abef33f9bdd10cc1990ed6
      path: modules/hal/xtensa

  self:
    path: zephyr-testing
    west-commands: scripts/west-commands.yml
```
