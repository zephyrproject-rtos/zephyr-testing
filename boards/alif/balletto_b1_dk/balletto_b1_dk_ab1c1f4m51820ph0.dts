/*
 * SPDX-FileCopyrightText: Copyright Alif Semiconductor
 * SPDX-License-Identifier: Apache-2.0
 */

/dts-v1/;

#include <alif/balletto/ab1c1f4m51820ph0.dtsi>
#include "balletto_b1_dk-pinctrl.dtsi"

/ {
	compatible = "alif,balletto-b1-dk-ab1c1f4m51820ph0";

	chosen {
		zephyr,flash = &mram;
		zephyr,sram = &dtcm;
		zephyr,console = &uart2;
		zephyr,shell-uart = &uart2;
	};
};

&uart2 {
	status = "okay";
	pinctrl-0 = <&pinctrl_uart2>;
	pinctrl-names = "default";
};

&i2c1 {
	pinctrl-0 = <&pinctrl_i2c1>;
	pinctrl-names = "default";
	/* status stays "disabled" until a shield/sample enables mikrobus_i2c */
};

/* Alias required by boards/shields/mikroe_weather_click/*.overlay */
mikrobus_i2c: &i2c1 {};
